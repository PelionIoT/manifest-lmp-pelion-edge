## conf/local.conf
```bitbake
# CONF_VERSION is increased each time build/conf/ changes incompatibly
CONF_VERSION = "1"

# Which files do we want to parse:
BBMASK = ""

# Don't generate the mirror tarball for SCM repos, the snapshot is enough
BB_GENERATE_MIRROR_TARBALLS = "0"

# Disable build time patch resolution. This would lauch a devshell
# and wait for manual intervention. We disable it.
PATCHRESOLVE = "noop"

#
# Parallelism Options
#
# These two options control how much parallelism BitBake should use. The first
# option determines how many tasks bitbake should run in parallel:
# Default to setting automatically based on cpu count
BB_NUMBER_THREADS ?= "${@oe.utils.cpu_count()}"
#
# The second option controls how many processes make should run in parallel
# when running compile tasks:
# Default to setting automatically based on cpu count
PARALLEL_MAKE ?= "-j ${@oe.utils.cpu_count()}"

#
# Shared-state files from other locations
#
# Shared state files are prebuilt cache data objects which can
# used to accelerate build time. This variable can be used to configure the
# system to search other mirror locations for these objects before it builds
# the data itself.
#
# This can be a filesystem directory, or a remote url such as http or ftp.
# These would contain the sstate-cache results from previous builds (possibly
# from other machines). This variable works like fetcher MIRRORS/PREMIRRORS
# and points to the cache locations to check for the shared objects.
#SSTATE_MIRRORS ?= "\
#file://.* https://storage.googleapis.com/lmp-cache/sstate-cache/PATH \n \
#"

# enable PR service on build machine itself
# its good for a case when this is the only builder
# generating the feeds
#PRSERV_HOST = "localhost:0"

#
# Default kernel provider
#
# The default kernel provider in the Linux microPlatform is 'linux-lmp', but
# if you wish to use the kernel provided by the board BSP layer, or your own
# kernel, replace the line below with the recipe name used by the desired
# kernel provider.
PREFERRED_PROVIDER_virtual/kernel ?= "linux-lmp"

#
# U-Boot / fitImage signing support
#
# Supported key type: RSA 2048
UBOOT_SIGN_KEYDIR ?= "${TOPDIR}/conf/keys"
UBOOT_SIGN_KEYNAME ?= "dev"
#UBOOT_SIGN_ENABLE ?= "1"

#
# OP-TEE: Custom TA signing key
#
# By default OP-TEE uses a development tree available as part of the git
# repository, which should only be used for development purposes. To use a
# custom signing key just generate a custom RSA 2048 key (PEM format) and
# set via the OPTEE_TA_SIGN_KEY variable.
OPTEE_TA_SIGN_KEY ?= "${TOPDIR}/conf/keys/dev.key"

ACCEPT_FSL_EULA = "1"

#Enable debug packages, compilers and debugging tools
#EXTRA_IMAGE_FEATURES = "dbg-pkgs tools-sdk tools-debug"

#DEBUG_BUILD = "1"

# Do not remove debug symbols
#INHIBIT_PACKAGE_STRIP = "1"

# OPTIONAL: Do not split debug symbols in a separate file
#INHIBIT_PACKAGE_DEBUG_SPLIT= "1"

# Not sure if this is required
#INHIBIT_SYSROOT_STRIP = "1"

#append these features to distro
DISTRO_FEATURES =+ "ipv4 ipv6 ext2 opengl usbhost virtualization k8s wifi"
GOVERSION = "1.15%"

#Enables serial console for raspberry pi
ENABLE_SERIAL_CONSOLE = "1"

# Uncomment following line to get pc-ble-driver into image.
# IMAGE_INSTALL_append = " pc-ble-driver"

# edge-kubelet is a modified version of Kubernetes' kubelet to enable kubelet interact with the Pelion cloud services
PREFERRED_RPROVIDER_kubelet = "kubelet"

# if persistent /var/log is desired, set the following to "no"
# persistent logging is required to enable Journald's Forware Secure Sealing (FSS) feature
VOLATILE_LOG_DIR = "no"

# Set default Pelion image name to mfg tool
MFGTOOL_FLASH_IMAGE = "console-image-lmp"
```
